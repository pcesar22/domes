## firmware/domes/main/Kconfig.projbuild
```kconfig
menu "DOMES Configuration"

    choice DOMES_RUNTIME_PROFILE
        prompt "DOMES runtime composition profile"
        default DOMES_RUNTIME_PROFILE_PHYSICAL

        config DOMES_RUNTIME_PROFILE_PHYSICAL
            bool "Physical NFF development board"

        config DOMES_RUNTIME_PROFILE_QEMU
            bool "Deterministic ESP32-S3 QEMU"
    endchoice

    config DOMES_OTA_AUTO_CHECK
        bool "Enable automatic OTA update check on boot"
        depends on DOMES_RUNTIME_PROFILE_PHYSICAL
        default n
        help
            When enabled, the firmware will automatically check GitHub
            for new releases on boot (requires WiFi connection).

            Disable this during development to avoid unexpected updates.

            For production, OTA updates are delivered via BLE from the
            phone app, not via WiFi auto-check.

    config DOMES_WIFI_AUTO_CONNECT
        bool "Enable automatic WiFi connection on boot"
        depends on DOMES_RUNTIME_PROFILE_PHYSICAL
        default n
        help
            When enabled, the firmware will automatically connect to WiFi
            using credentials stored in NVS or from secrets.hpp.

            You must create main/secrets.hpp with your WiFi credentials.
            See main/secrets.hpp.example for the template.

endmenu
```

## firmware/qemu_probe/link/main/Kconfig.projbuild
```kconfig
menu "DOMES QEMU link probe"

config DOMES_RUNTIME_PROFILE_QEMU
    bool
    default y

endmenu
```

## firmware/qemu_probe/link/sdkconfig.defaults
```kconfig
CONFIG_IDF_TARGET="esp32s3"
CONFIG_APP_REPRODUCIBLE_BUILD=y
CONFIG_ESPTOOLPY_FLASHSIZE_8MB=y
CONFIG_ESP_CONSOLE_UART_DEFAULT=y
CONFIG_ESP_MAIN_TASK_STACK_SIZE=4096
CONFIG_ESP_MAIN_TASK_AFFINITY_CPU0=y
CONFIG_FREERTOS_HZ=1000
# CONFIG_FREERTOS_UNICORE is not set
# CONFIG_ESP_TASK_WDT_EN is not set
CONFIG_LOG_DEFAULT_LEVEL_INFO=y
CONFIG_LOG_COLORS=n
CONFIG_COMPILER_CXX_EXCEPTIONS=n
CONFIG_COMPILER_CXX_RTTI=n
```
