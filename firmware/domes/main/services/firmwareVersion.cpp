#include "firmwareVersion.hpp"

#include <cctype>
#include <cstdint>
#include <cstring>
#include <limits>

namespace domes {
namespace {

bool parseUint32(const char*& cursor, uint32_t& value) {
    if (!cursor || !std::isdigit(static_cast<unsigned char>(*cursor))) {
        return false;
    }

    uint64_t parsed = 0;
    do {
        parsed = parsed * 10 + static_cast<uint64_t>(*cursor - '0');
        if (parsed > std::numeric_limits<uint32_t>::max()) {
            return false;
        }
        ++cursor;
    } while (std::isdigit(static_cast<unsigned char>(*cursor)));

    value = static_cast<uint32_t>(parsed);
    return true;
}

bool consume(const char*& cursor, char expected) {
    if (*cursor != expected) {
        return false;
    }
    ++cursor;
    return true;
}

}  // namespace

int FirmwareVersion::compare(const FirmwareVersion& other) const {
    if (valid != other.valid) {
        return valid ? 1 : -1;
    }
    if (!valid) {
        return 0;
    }
    if (major != other.major) {
        return major < other.major ? -1 : 1;
    }
    if (minor != other.minor) {
        return minor < other.minor ? -1 : 1;
    }
    if (patch != other.patch) {
        return patch < other.patch ? -1 : 1;
    }
    return 0;
}

bool FirmwareVersion::isUpdateAvailable(const FirmwareVersion& other) const {
    return valid && other.valid && compare(other) < 0;
}

FirmwareVersion parseVersion(const char* versionString) {
    FirmwareVersion version;
    if (!versionString || *versionString == '\0') {
        return version;
    }

    const char* cursor = versionString;
    if (*cursor == 'v' || *cursor == 'V') {
        ++cursor;
    }

    if (!parseUint32(cursor, version.major) || !consume(cursor, '.') ||
        !parseUint32(cursor, version.minor) || !consume(cursor, '.') ||
        !parseUint32(cursor, version.patch)) {
        return {};
    }

    if (*cursor == '\0') {
        version.valid = true;
        return version;
    }

    if (std::strcmp(cursor, "-dirty") == 0) {
        version.dirty = true;
        version.valid = true;
        return version;
    }

    // Validate the exact suffix generated by `git describe --long`.
    if (!consume(cursor, '-')) {
        return {};
    }
    uint32_t commitsSinceTag = 0;
    if (!parseUint32(cursor, commitsSinceTag) || !consume(cursor, '-') || !consume(cursor, 'g')) {
        return {};
    }
    (void)commitsSinceTag;

    size_t hashLength = 0;
    while (std::isxdigit(static_cast<unsigned char>(*cursor))) {
        if (hashLength >= sizeof(version.gitHash) - 1) {
            return {};
        }
        version.gitHash[hashLength++] = *cursor++;
    }
    if (hashLength == 0) {
        return {};
    }
    version.gitHash[hashLength] = '\0';

    if (*cursor != '\0') {
        if (std::strcmp(cursor, "-dirty") != 0) {
            return {};
        }
        version.dirty = true;
    }

    version.valid = true;
    return version;
}

bool firmwareVersionsMatchExactly(const char* declaredVersion, const char* embeddedVersion) {
    return declaredVersion != nullptr && embeddedVersion != nullptr &&
           parseVersion(declaredVersion).valid && parseVersion(embeddedVersion).valid &&
           std::strcmp(declaredVersion, embeddedVersion) == 0;
}

}  // namespace domes
