## firmware/domes/sdkconfig.defaults
```kconfig
# DOMES Firmware Configuration Defaults
# Target: ESP32-S3-DevKitC-1
CONFIG_IDF_TARGET="esp32s3"

# Console output via USB Serial/JTAG (native USB port)
CONFIG_ESP_CONSOLE_USB_SERIAL_JTAG=y

# Flash size (DevKitC-1 has 8MB, but we target 16MB for production)
CONFIG_ESPTOOLPY_FLASHSIZE_8MB=y
CONFIG_ESPTOOLPY_FLASHMODE_QIO=y
CONFIG_ESPTOOLPY_FLASHFREQ_80M=y

# Partition table
CONFIG_PARTITION_TABLE_CUSTOM=y
CONFIG_PARTITION_TABLE_CUSTOM_FILENAME="partitions.csv"

# FreeRTOS settings
CONFIG_FREERTOS_HZ=1000
CONFIG_FREERTOS_USE_TRACE_FACILITY=y

# Main task stack size (default is 3584, keep reasonable)
CONFIG_ESP_MAIN_TASK_STACK_SIZE=4096

# Logging
CONFIG_LOG_DEFAULT_LEVEL_INFO=y
CONFIG_LOG_COLORS=y

# Task Watchdog Timer (TWDT)
CONFIG_ESP_TASK_WDT_EN=y
CONFIG_ESP_TASK_WDT_INIT=n
CONFIG_ESP_TASK_WDT_TIMEOUT_S=10
CONFIG_ESP_TASK_WDT_CHECK_IDLE_TASK_CPU0=n
CONFIG_ESP_TASK_WDT_CHECK_IDLE_TASK_CPU1=n

# Core dump for debugging
CONFIG_ESP_COREDUMP_ENABLE_TO_FLASH=y
CONFIG_ESP_COREDUMP_DATA_FORMAT_ELF=y

# C++ exceptions disabled (per guidelines)
CONFIG_COMPILER_CXX_EXCEPTIONS=n

# RTTI disabled (per guidelines)
CONFIG_COMPILER_CXX_RTTI=n

# WiFi Configuration
CONFIG_ESP_WIFI_STATIC_RX_BUFFER_NUM=10
CONFIG_ESP_WIFI_DYNAMIC_RX_BUFFER_NUM=32
CONFIG_ESP_WIFI_AMPDU_TX_ENABLED=y
CONFIG_ESP_WIFI_AMPDU_RX_ENABLED=y

# SmartConfig for WiFi provisioning
CONFIG_ESP_SMARTCONFIG_ENABLE=y

# HTTPS support for OTA
CONFIG_ESP_TLS_USING_MBEDTLS=y
CONFIG_MBEDTLS_SSL_MAX_CONTENT_LEN=16384
CONFIG_MBEDTLS_CERTIFICATE_BUNDLE=y
CONFIG_MBEDTLS_CERTIFICATE_BUNDLE_DEFAULT_FULL=y

# Bluetooth Low Energy (NimBLE)
CONFIG_BT_ENABLED=y
CONFIG_BT_NIMBLE_ENABLED=y
CONFIG_BT_NIMBLE_MAX_CONNECTIONS=1
CONFIG_BT_NIMBLE_MAX_BONDS=3
CONFIG_BT_NIMBLE_ROLE_PERIPHERAL=y
CONFIG_BT_NIMBLE_ROLE_CENTRAL=n
CONFIG_BT_NIMBLE_ROLE_OBSERVER=n
CONFIG_BT_NIMBLE_ROLE_BROADCASTER=y
CONFIG_BT_NIMBLE_ATT_PREFERRED_MTU=517
CONFIG_BT_NIMBLE_GAP_DEVICE_NAME_MAX_LEN=32
CONFIG_BT_NIMBLE_SVC_GAP_DEVICE_NAME="DOMES-Pod"
CONFIG_BT_NIMBLE_GATT_MAX_PROCS=4
```

## firmware/main/Kconfig.projbuild
```kconfig
menu "DOMES Configuration"

    choice DOMES_PLATFORM
        prompt "Target Platform"
        default DOMES_PLATFORM_DEVKIT
        help
            Select the target hardware platform for the build.

        config DOMES_PLATFORM_DEVKIT
            bool "ESP32-S3 DevKit"
            help
                Build for ESP32-S3-DevKitC-1 or similar development board.
                Use this for initial development before custom PCB.

        config DOMES_PLATFORM_PCB_V1
            bool "DOMES PCB v1"
            help
                Build for the first revision of the custom DOMES PCB.

    endchoice

    config DOMES_LED_COUNT
        int "Number of LEDs in ring"
        default 16
        range 1 64
        help
            Number of SK6812 RGBW LEDs in the LED ring.

    config DOMES_HAS_HAPTIC
        bool "Enable haptic motor driver"
        default y
        help
            Enable support for DRV2605L haptic motor driver.
            Disable if the hardware does not have a haptic motor.

    config DOMES_HAS_AUDIO
        bool "Enable audio output"
        default y
        help
            Enable support for MAX98357A I2S audio amplifier.
            Disable if the hardware does not have a speaker.

    config DOMES_HAS_IMU
        bool "Enable IMU (accelerometer)"
        default y
        help
            Enable support for LIS2DW12 accelerometer.
            Disable if the hardware does not have an IMU.

    config DOMES_TOUCH_CHANNELS
        int "Number of touch channels"
        default 4
        range 1 14
        help
            Number of capacitive touch channels to use.
            ESP32-S3 supports up to 14 touch-capable GPIOs.

    menu "Network Configuration"

        config DOMES_MAX_PODS
            int "Maximum number of pods"
            default 24
            range 2 32
            help
                Maximum number of pods that can be connected in a network.

        config DOMES_ESPNOW_CHANNEL
            int "ESP-NOW WiFi channel"
            default 1
            range 1 14
            help
                WiFi channel for ESP-NOW communication.
                All pods must use the same channel.

    endmenu

    menu "Debug Configuration"

        config DOMES_ENABLE_SMOKE_TEST
            bool "Enable hardware smoke tests"
            default y
            help
                Build in hardware self-test routines.
                Hold button during boot to trigger.

        config DOMES_LOG_LEVEL_VERBOSE
            bool "Enable verbose logging"
            default n
            help
                Enable ESP_LOGV verbose log messages.
                Increases binary size and log output.

    endmenu

endmenu
```

## firmware/sdkconfig.defaults
```kconfig
# DOMES Firmware - Default SDK Configuration
# Target: ESP32-S3-WROOM-1-N16R8

# ============================================
# Target Selection
# ============================================
CONFIG_IDF_TARGET="esp32s3"

# ============================================
# Flash Configuration (16MB)
# ============================================
CONFIG_ESPTOOLPY_FLASHSIZE_16MB=y
CONFIG_ESPTOOLPY_FLASHSIZE="16MB"
CONFIG_ESPTOOLPY_FLASHMODE_QIO=y
CONFIG_ESPTOOLPY_FLASHFREQ_80M=y

# ============================================
# PSRAM Configuration (8MB)
# ============================================
CONFIG_SPIRAM=y
CONFIG_SPIRAM_MODE_OCT=y
CONFIG_SPIRAM_SPEED_80M=y

# ============================================
# Partition Table
# ============================================
CONFIG_PARTITION_TABLE_CUSTOM=y
CONFIG_PARTITION_TABLE_CUSTOM_FILENAME="partitions.csv"
CONFIG_PARTITION_TABLE_FILENAME="partitions.csv"

# ============================================
# CPU Configuration
# ============================================
CONFIG_ESP_DEFAULT_CPU_FREQ_MHZ_240=y

# ============================================
# FreeRTOS Configuration
# ============================================
CONFIG_FREERTOS_HZ=1000
CONFIG_FREERTOS_USE_TICKLESS_IDLE=n
CONFIG_FREERTOS_TIMER_TASK_STACK_DEPTH=3072

# ============================================
# C++ Configuration
# ============================================
CONFIG_COMPILER_CXX_EXCEPTIONS=n
CONFIG_COMPILER_CXX_RTTI=n
CONFIG_COMPILER_OPTIMIZATION_SIZE=y

# ============================================
# Logging Configuration
# ============================================
CONFIG_LOG_DEFAULT_LEVEL_INFO=y
CONFIG_LOG_MAXIMUM_LEVEL_DEBUG=y
CONFIG_LOG_COLORS=y

# ============================================
# USB Configuration (Native USB)
# ============================================
CONFIG_ESP_CONSOLE_USB_SERIAL_JTAG=y

# ============================================
# WiFi Configuration
# ============================================
CONFIG_ESP_WIFI_STATIC_RX_BUFFER_NUM=10
CONFIG_ESP_WIFI_DYNAMIC_RX_BUFFER_NUM=32
CONFIG_ESP_WIFI_AMPDU_TX_ENABLED=y
CONFIG_ESP_WIFI_AMPDU_RX_ENABLED=y

# ============================================
# Bluetooth Configuration
# ============================================
CONFIG_BT_ENABLED=y
CONFIG_BT_NIMBLE_ENABLED=y
CONFIG_BT_NIMBLE_MAX_CONNECTIONS=3

# ============================================
# ESP-NOW Configuration
# ============================================
CONFIG_ESP_WIFI_ESPNOW_MAX_ENCRYPT_NUM=7

# ============================================
# Touch Sensor Configuration
# ============================================
CONFIG_ESP32_ULP_COPROC_ENABLED=y

# ============================================
# Power Management
# ============================================
CONFIG_PM_ENABLE=y
CONFIG_PM_DFS_INIT_AUTO=y

# ============================================
# Watchdog Configuration
# ============================================
CONFIG_ESP_TASK_WDT_TIMEOUT_S=10
CONFIG_ESP_TASK_WDT_CHECK_IDLE_TASK_CPU0=y
CONFIG_ESP_TASK_WDT_CHECK_IDLE_TASK_CPU1=y

# ============================================
# DOMES Custom Configuration (defaults)
# ============================================
CONFIG_DOMES_PLATFORM_DEVKIT=y
CONFIG_DOMES_LED_COUNT=16
CONFIG_DOMES_HAS_HAPTIC=y
CONFIG_DOMES_HAS_AUDIO=y
CONFIG_DOMES_HAS_IMU=y
```

## firmware/test_app/sdkconfig.defaults
```kconfig
# DOMES Unit Test App Configuration
#
# Minimal config for running tests on Linux target

# Enable Unity test framework
CONFIG_UNITY_ENABLE_FLOAT=y
CONFIG_UNITY_ENABLE_DOUBLE=y

# Disable hardware-specific features for Linux target
CONFIG_FREERTOS_UNICORE=y

# C++ features
CONFIG_COMPILER_CXX_EXCEPTIONS=n
CONFIG_COMPILER_CXX_RTTI=n

# Logging
CONFIG_LOG_DEFAULT_LEVEL_INFO=y
```
